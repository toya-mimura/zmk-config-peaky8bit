#include "peaky8bit.dtsi"

&kscan {
    input-gpios
        = <&xiao_d 0 (GPIO_ACTIVE_LOW | GPIO_PULL_UP)>
        , <&xiao_d 1 (GPIO_ACTIVE_LOW | GPIO_PULL_UP)>
        , <&xiao_d 2 (GPIO_ACTIVE_LOW | GPIO_PULL_UP)>
        , <&xiao_d 3 (GPIO_ACTIVE_LOW | GPIO_PULL_UP)>
        ;
};