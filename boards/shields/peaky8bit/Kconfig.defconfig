## boards/shields/peaky8bit/Kconfig.defconfig
```kconfig
if SHIELD_PEAKY8BIT_LEFT

config ZMK_KEYBOARD_NAME
    default "peaky8bit"

config ZMK_SPLIT_ROLE_CENTRAL
    default y

endif # SHIELD_PEAKY8BIT_LEFT

if SHIELD_PEAKY8BIT_LEFT || SHIELD_PEAKY8BIT_RIGHT

config ZMK_SPLIT
    default y

endif # SHIELD_PEAKY8BIT_LEFT || SHIELD_PEAKY8BIT_RIGHT
```

## boards/shields/peaky8bit/Kconfig.shield
```kconfig
config SHIELD_PEAKY8BIT_LEFT
    def_bool $(shields_list_contains,peaky8bit_left)

config SHIELD_PEAKY8BIT_RIGHT
    def_bool $(shields_list_contains,peaky8bit_right)
```
